## impl/firmware/main/Kconfig.projbuild
```kconfig
menu "PA Reader"

config PAREADER_PN532_SDA_GPIO
    int "PN532 SDA GPIO"
    default 2

config PAREADER_PN532_SCL_GPIO
    int "PN532 SCL GPIO"
    default 3

endmenu
```

## impl/firmware/sdkconfig.defaults
```kconfig
CONFIG_TINYUSB_CDC_ENABLED=y
CONFIG_TINYUSB_CDC_COUNT=1
CONFIG_TINYUSB_HID_COUNT=2
CONFIG_ESP_MAIN_TASK_STACK_SIZE=8192
```
